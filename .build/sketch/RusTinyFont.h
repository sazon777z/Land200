#line 1 "C:\\Users\\JZX\\Documents\\Arduino\\Land_Cruiser\\RusTinyFont.h"
#ifndef RUS_TINY_FONT_H
#define RUS_TINY_FONT_H

#include <Arduino.h>
#include <Arduino_GFX_Library.h>

namespace RusTinyFont {
constexpr uint8_t kGlyphWidth = 5;
constexpr uint8_t kGlyphHeight = 7;
constexpr uint8_t kDefaultAdvance = 6;

struct Glyph {
  uint16_t codepoint;
  uint8_t advance;
  uint8_t rows[kGlyphHeight];
};

static const Glyph kGlyphs[] = {
    {' ', 4, {0x00, 0x00, 0x00, 0x00, 0x00, 0x00, 0x00}},
    {',', 3, {0x00, 0x00, 0x00, 0x00, 0x00, 0x06, 0x04}},
    {'0', 6, {0x0E, 0x11, 0x13, 0x15, 0x19, 0x11, 0x0E}},
    {'1', 6, {0x04, 0x0C, 0x14, 0x04, 0x04, 0x04, 0x1F}},
    {'2', 6, {0x0E, 0x11, 0x01, 0x06, 0x08, 0x10, 0x1F}},
    {'3', 6, {0x1E, 0x01, 0x01, 0x0E, 0x01, 0x01, 0x1E}},
    {'4', 6, {0x02, 0x06, 0x0A, 0x12, 0x1F, 0x02, 0x02}},
    {'5', 6, {0x1F, 0x10, 0x10, 0x1E, 0x01, 0x01, 0x1E}},
    {'6', 6, {0x06, 0x08, 0x10, 0x1E, 0x11, 0x11, 0x0E}},
    {'7', 6, {0x1F, 0x01, 0x02, 0x04, 0x08, 0x08, 0x08}},
    {'8', 6, {0x0E, 0x11, 0x11, 0x0E, 0x11, 0x11, 0x0E}},
    {'9', 6, {0x0E, 0x11, 0x11, 0x0F, 0x01, 0x02, 0x0C}},
    {0x0410, 6, {0x0E, 0x11, 0x11, 0x1F, 0x11, 0x11, 0x11}}, // А
    {0x0411, 6, {0x1F, 0x10, 0x1E, 0x11, 0x11, 0x11, 0x1E}}, // Б
    {0x0412, 6, {0x1E, 0x11, 0x11, 0x1E, 0x11, 0x11, 0x1E}}, // В
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    {0x042C, 6, {0x10, 0x10, 0x1E, 0x11, 0x11, 0x11, 0x1E}}, // Ь
};

inline const Glyph *findGlyph(uint32_t codepoint) {
  for (const auto &glyph : kGlyphs) {
    if (glyph.codepoint == codepoint) {
      return &glyph;
    }
  }
  return nullptr;
}

inline uint32_t decodeNext(const String &text, int &index) {
  const uint8_t lead = static_cast<uint8_t>(text.charAt(index++));
  if ((lead & 0x80) == 0) {
    return lead;
  }

  if ((lead & 0xE0) == 0xC0 && index < text.length()) {
    const uint8_t tail = static_cast<uint8_t>(text.charAt(index++));
    return ((lead & 0x1F) << 6) | (tail & 0x3F);
  }

  if ((lead & 0xF0) == 0xE0 && (index + 1) < text.length()) {
    const uint8_t tail1 = static_cast<uint8_t>(text.charAt(index++));
    const uint8_t tail2 = static_cast<uint8_t>(text.charAt(index++));
    return ((lead & 0x0F) << 12) | ((tail1 & 0x3F) << 6) | (tail2 & 0x3F);
  }

  return '?';
}

inline int measureText(const String &text, int scale = 1) {
  int width = 0;
  int index = 0;
  while (index < text.length()) {
    const uint32_t codepoint = decodeNext(text, index);
    const Glyph *glyph = findGlyph(codepoint);
    width += (glyph != nullptr ? glyph->advance : kDefaultAdvance) * scale;
  }
  return width > 0 ? width - scale : 0;
}

inline void drawText(Arduino_GFX *target, int x, int y, const String &text,
                     uint16_t color, int scale = 1) {
  int cursorX = x;
  int index = 0;
  while (index < text.length()) {
    const uint32_t codepoint = decodeNext(text, index);
    const Glyph *glyph = findGlyph(codepoint);

    const uint8_t advance =
        (glyph != nullptr ? glyph->advance : kDefaultAdvance) * scale;

    if (glyph == nullptr) {
      cursorX += advance;
      continue;
    }

    for (uint8_t row = 0; row < kGlyphHeight; ++row) {
      for (uint8_t col = 0; col < kGlyphWidth; ++col) {
        if (glyph->rows[row] & (1 << (kGlyphWidth - 1 - col))) {
          target->fillRect(cursorX + col * scale, y + row * scale, scale, scale,
                           color);
        }
      }
    }

    cursorX += advance;
  }
}
} // namespace RusTinyFont

#endif // RUS_TINY_FONT_H
